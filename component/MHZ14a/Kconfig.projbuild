## component/MHZ14a/Kconfig.projbuild
```kconfig
menu "MHZ14a configuration"

    config MHZ14A_PWM_PIN
        int "PMW PIN GPIO Number"
        default 32
        help
            GPIO number for PWM PIN.

    config QUEUE_SIZE
        int "Max size queue"
        default 1
        help
            Max size queue for store capture PWM.

    config HD_PIN
        int "HD PIIN GPIO number"
        default 33
        help 
            GPIO number for HD PIN, using for zero-point calibration(auto calibartion).

    choice MHZ14A_PROTOCOL_COMMUNICATION
        prompt "MHZ14a protocol"
        default MHZ14A_PWM
        help
            MHZ14a protocol communication to get data.

        config MHZ14A_PWM
            bool "PWM"
            default 1
        config MHZ14A_UART
            bool "UART"
            default 0

        
    endchoice

    menu "MHZ14a UART configuration"
        depends on MHZ14A_UART

        config MHZ14A_PIN_TX
            int "TX GPIO Number"
            default 1
            help
                GPIO number for TX.
        
        config MHZ14A_PIN_RX
            int "RX GPIO Number"
            default 3
            help
                GPIO number for RX.
        
        config MHZ14A_UART_BAUD_RATE
            int "UART baudrate"
            default 9600
            help
                UART baudrate.
        
        config MHZ14A_UART_PORT
            int "Uart Port"
            default 2
            help 
                UART port for PMS sensor.
        
    endmenu
endmenu

menu "Example Configuration"

    config ESP_WIFI_SSID
        string "WiFi SSID"
        default "myssid"
        help
            SSID (network name) for the example to connect to.

    config ESP_WIFI_PASSWORD
        string "WiFi Password"
        default "mypassword"
        help
            WiFi password (WPA or WPA2) for the example to use.

    choice ESP_WIFI_SAE_MODE
        prompt "WPA3 SAE mode selection"
        default ESP_WPA3_SAE_PWE_BOTH
        help
            Select mode for SAE as Hunt and Peck, H2E or both.
        config ESP_WPA3_SAE_PWE_HUNT_AND_PECK
            bool "HUNT AND PECK"
        config ESP_WPA3_SAE_PWE_HASH_TO_ELEMENT
            bool "H2E"
        config ESP_WPA3_SAE_PWE_BOTH
            bool "BOTH"
    endchoice

    config ESP_WIFI_PW_ID
        string "PASSWORD IDENTIFIER"
        depends on  ESP_WPA3_SAE_PWE_HASH_TO_ELEMENT|| ESP_WPA3_SAE_PWE_BOTH
        default ""
        help
            password identifier for SAE H2E

    config ESP_MAXIMUM_RETRY
        int "Maximum retry"
        default 5
        help
            Set the Maximum retry to avoid station reconnecting to the AP unlimited when the AP is really inexistent.

    choice ESP_WIFI_SCAN_AUTH_MODE_THRESHOLD
        prompt "WiFi Scan auth mode threshold"
        default ESP_WIFI_AUTH_WPA2_PSK
        help
            The weakest authmode to accept in the scan mode.
            This value defaults to ESP_WIFI_AUTH_WPA2_PSK incase password is present and ESP_WIFI_AUTH_OPEN is used.
            Please select ESP_WIFI_AUTH_WEP/ESP_WIFI_AUTH_WPA_PSK incase AP is operating in WEP/WPA mode.

        config ESP_WIFI_AUTH_OPEN
            bool "OPEN"
        config ESP_WIFI_AUTH_WEP
            bool "WEP"
        config ESP_WIFI_AUTH_WPA_PSK
            bool "WPA PSK"
        config ESP_WIFI_AUTH_WPA2_PSK
            bool "WPA2 PSK"
        config ESP_WIFI_AUTH_WPA_WPA2_PSK
            bool "WPA/WPA2 PSK"
        config ESP_WIFI_AUTH_WPA3_PSK
            bool "WPA3 PSK"
        config ESP_WIFI_AUTH_WPA2_WPA3_PSK
            bool "WPA2/WPA3 PSK"
        config ESP_WIFI_AUTH_WAPI_PSK
            bool "WAPI PSK"
    endchoice

endmenu
```
